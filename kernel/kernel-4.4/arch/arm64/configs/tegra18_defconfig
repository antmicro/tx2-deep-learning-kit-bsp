## kernel/kernel-4.4/arch/arm64/configs/tegra21_min_defconfig
```kconfig
CONFIG_ARCH_TEGRA_210_SOC=y
# CONFIG_LOCALVERSION_AUTO is not set
CONFIG_SYSVIPC=y
CONFIG_FHANDLE=y
# CONFIG_USELIB is not set
CONFIG_AUDIT=y
CONFIG_AUDITSYSCALL=y
CONFIG_NO_HZ=y
CONFIG_HIGH_RES_TIMERS=y
CONFIG_IKCONFIG=y
CONFIG_IKCONFIG_PROC=y
CONFIG_CGROUPS=y
CONFIG_CGROUP_DEBUG=y
CONFIG_CGROUP_FREEZER=y
CONFIG_CGROUP_CPUACCT=y
CONFIG_CGROUP_SCHED=y
CONFIG_RT_GROUP_SCHED=y
CONFIG_BLK_DEV_INITRD=y
# CONFIG_RD_LZMA is not set
# CONFIG_RD_XZ is not set
# CONFIG_RD_LZO is not set
# CONFIG_RD_LZ4 is not set
CONFIG_KALLSYMS_ALL=y
# CONFIG_ELF_CORE is not set
CONFIG_EMBEDDED=y
CONFIG_PERF_EVENTS=y
CONFIG_MODULES=y
CONFIG_MODULE_UNLOAD=y
CONFIG_MODULE_FORCE_UNLOAD=y
# CONFIG_BLK_DEV_BSG is not set
CONFIG_BLK_DEV_INTEGRITY=y
CONFIG_PARTITION_ADVANCED=y
CONFIG_DEFAULT_NOOP=y
CONFIG_ARCH_TEGRA=y
CONFIG_NR_CPUS=8
CONFIG_HOTPLUG_CPU=y
CONFIG_PREEMPT=y
# CONFIG_KSM is not set
CONFIG_ARMV8_DEPRECATED=y
CONFIG_CP15_BARRIER_EMULATION=y
# CONFIG_EFI is not set
CONFIG_COMPAT=y
# CONFIG_SUSPEND is not set
CONFIG_CPU_IDLE=y
CONFIG_NET=y
CONFIG_PACKET=y
CONFIG_UNIX=y
CONFIG_XFRM_USER=y
CONFIG_NET_KEY=y
CONFIG_INET=y
CONFIG_IP_MULTICAST=y
CONFIG_IP_ADVANCED_ROUTER=y
CONFIG_IP_MULTIPLE_TABLES=y
CONFIG_IP_PNP=y
CONFIG_IP_PNP_DHCP=y
CONFIG_IP_PNP_BOOTP=y
CONFIG_IP_PNP_RARP=y
CONFIG_NET_IPIP=y
CONFIG_IP_MROUTE=y
CONFIG_INET_AH=y
CONFIG_INET_ESP=y
CONFIG_INET_IPCOMP=y
# CONFIG_INET_LRO is not set
CONFIG_IPV6_ROUTER_PREF=y
CONFIG_IPV6_ROUTE_INFO=y
CONFIG_IPV6_OPTIMISTIC_DAD=y
CONFIG_INET6_AH=y
CONFIG_INET6_ESP=y
CONFIG_INET6_IPCOMP=y
CONFIG_IPV6_MIP6=y
CONFIG_IPV6_TUNNEL=y
CONFIG_IPV6_MULTIPLE_TABLES=y
CONFIG_NETWORK_SECMARK=y
CONFIG_NETFILTER=y
CONFIG_NF_CONNTRACK=y
# CONFIG_NF_CONNTRACK_PROCFS is not set
CONFIG_NF_CONNTRACK_EVENTS=y
CONFIG_NF_CT_PROTO_DCCP=y
CONFIG_NF_CT_PROTO_SCTP=y
CONFIG_NF_CT_PROTO_UDPLITE=y
CONFIG_NF_CONNTRACK_AMANDA=y
CONFIG_NF_CONNTRACK_FTP=y
CONFIG_NF_CONNTRACK_H323=y
CONFIG_NF_CONNTRACK_IRC=y
CONFIG_NF_CONNTRACK_NETBIOS_NS=y
CONFIG_NF_CONNTRACK_PPTP=y
CONFIG_NF_CONNTRACK_SANE=y
CONFIG_NF_CONNTRACK_TFTP=y
CONFIG_NF_CT_NETLINK=y
CONFIG_NETFILTER_XT_TARGET_CLASSIFY=y
CONFIG_NETFILTER_XT_TARGET_CONNMARK=y
CONFIG_NETFILTER_XT_TARGET_IDLETIMER=y
CONFIG_NETFILTER_XT_TARGET_MARK=y
CONFIG_NETFILTER_XT_TARGET_NFLOG=y
CONFIG_NETFILTER_XT_TARGET_NFQUEUE=y
CONFIG_NETFILTER_XT_TARGET_TPROXY=y
CONFIG_NETFILTER_XT_TARGET_TRACE=y
CONFIG_NETFILTER_XT_TARGET_TCPMSS=y
CONFIG_NETFILTER_XT_MATCH_COMMENT=y
CONFIG_NETFILTER_XT_MATCH_CONNBYTES=y
CONFIG_NETFILTER_XT_MATCH_CONNLIMIT=y
CONFIG_NETFILTER_XT_MATCH_CONNMARK=y
CONFIG_NETFILTER_XT_MATCH_CONNTRACK=y
CONFIG_NETFILTER_XT_MATCH_HASHLIMIT=y
CONFIG_NETFILTER_XT_MATCH_HELPER=y
CONFIG_NETFILTER_XT_MATCH_IPRANGE=y
CONFIG_NETFILTER_XT_MATCH_LENGTH=y
CONFIG_NETFILTER_XT_MATCH_LIMIT=y
CONFIG_NETFILTER_XT_MATCH_MAC=y
CONFIG_NETFILTER_XT_MATCH_MARK=y
CONFIG_NETFILTER_XT_MATCH_POLICY=y
CONFIG_NETFILTER_XT_MATCH_PKTTYPE=y
CONFIG_NETFILTER_XT_MATCH_QTAGUID=y
CONFIG_NETFILTER_XT_MATCH_QUOTA=y
CONFIG_NETFILTER_XT_MATCH_QUOTA2=y
CONFIG_NETFILTER_XT_MATCH_SOCKET=y
CONFIG_NETFILTER_XT_MATCH_STATE=y
CONFIG_NETFILTER_XT_MATCH_STATISTIC=y
CONFIG_NETFILTER_XT_MATCH_STRING=y
CONFIG_NETFILTER_XT_MATCH_TIME=y
CONFIG_NETFILTER_XT_MATCH_U32=y
CONFIG_NF_CONNTRACK_IPV4=y
CONFIG_NF_NAT_IPV4=y
CONFIG_IP_NF_IPTABLES=y
CONFIG_IP_NF_MATCH_AH=y
CONFIG_IP_NF_MATCH_ECN=y
CONFIG_IP_NF_MATCH_TTL=y
CONFIG_IP_NF_FILTER=y
CONFIG_IP_NF_TARGET_REJECT=y
CONFIG_IP_NF_MANGLE=y
CONFIG_IP_NF_RAW=y
CONFIG_IP_NF_ARPTABLES=y
CONFIG_IP_NF_ARPFILTER=y
CONFIG_IP_NF_ARP_MANGLE=y
CONFIG_NF_CONNTRACK_IPV6=y
CONFIG_IP6_NF_IPTABLES=y
CONFIG_IP6_NF_FILTER=y
CONFIG_IP6_NF_TARGET_REJECT=y
CONFIG_IP6_NF_MANGLE=y
CONFIG_IP6_NF_RAW=y
CONFIG_NET_SCHED=y
CONFIG_NET_SCH_HTB=y
CONFIG_NET_SCH_INGRESS=y
CONFIG_NET_CLS_U32=y
CONFIG_NET_EMATCH=y
CONFIG_NET_EMATCH_U32=y
CONFIG_NET_CLS_ACT=y
CONFIG_NET_ACT_POLICE=y
CONFIG_NET_ACT_GACT=y
CONFIG_NET_ACT_MIRRED=y
CONFIG_CFG80211=y
CONFIG_NL80211_TESTMODE=y
CONFIG_RFKILL=y
# CONFIG_FW_LOADER is not set
CONFIG_DMA_CMA=y
CONFIG_OF_PLUGIN_MANAGER=y
CONFIG_BLK_DEV_LOOP=y
CONFIG_BLK_DEV_RAM=y
CONFIG_BLK_DEV_RAM_SIZE=8192
CONFIG_TEGRA_CRYPTO_DEV=y
CONFIG_SCSI=y
CONFIG_BLK_DEV_SD=y
CONFIG_INPUT_JOYDEV=y
CONFIG_INPUT_EVDEV=y
CONFIG_INPUT_KEYRESET=y
CONFIG_KEYBOARD_GPIO=y
# CONFIG_INPUT_MOUSE is not set
CONFIG_INPUT_JOYSTICK=y
CONFIG_INPUT_TABLET=y
CONFIG_INPUT_TOUCHSCREEN=y
CONFIG_TOUCHSCREEN_LR388K7=y
CONFIG_TOUCHSCREEN_RM31080A=y
CONFIG_INPUT_MISC=y
CONFIG_INPUT_KEYCHORD=y
CONFIG_INPUT_UINPUT=y
CONFIG_INPUT_GPIO=y
# CONFIG_VT is not set
# CONFIG_LEGACY_PTYS is not set
# CONFIG_DEVKMEM is not set
CONFIG_SERIAL_8250=y
CONFIG_SERIAL_8250_CONSOLE=y
CONFIG_SERIAL_TEGRA=y
CONFIG_SERIAL_OF_PLATFORM=y
# CONFIG_HW_RANDOM is not set
CONFIG_I2C=y
CONFIG_I2C_CHARDEV=y
CONFIG_I2C_MUX=y
CONFIG_I2C_MUX_PCA954x=y
CONFIG_I2C_TEGRA=y
CONFIG_SPI=y
CONFIG_SPI_TEGRA114=y
CONFIG_PINCTRL_MAX77620=y
CONFIG_GPIO_SYSFS=y
CONFIG_GPIO_PCA953X=y
CONFIG_GPIO_PCA953X_IRQ=y
CONFIG_GPIO_MAX77620=y
# CONFIG_HWMON is not set
CONFIG_WATCHDOG=y
CONFIG_WATCHDOG_NOWAYOUT=y
CONFIG_TEGRA_WATCHDOG=y
CONFIG_MFD_MAX77620=y
CONFIG_REGULATOR=y
CONFIG_REGULATOR_FIXED_VOLTAGE=y
CONFIG_REGULATOR_GPIO=y
CONFIG_REGULATOR_MAX77620=y
CONFIG_REGULATOR_MAX8973=y
CONFIG_REGULATOR_PWM=y
CONFIG_REGULATOR_TPS65132=y
CONFIG_MEDIA_SUPPORT=y
CONFIG_MEDIA_CAMERA_SUPPORT=y
CONFIG_MEDIA_RC_SUPPORT=y
CONFIG_MEDIA_CONTROLLER=y
CONFIG_VIDEO_V4L2_SUBDEV_API=y
# CONFIG_IR_RC5_DECODER is not set
# CONFIG_IR_RC6_DECODER is not set
# CONFIG_IR_JVC_DECODER is not set
# CONFIG_IR_SONY_DECODER is not set
# CONFIG_IR_SANYO_DECODER is not set
# CONFIG_IR_MCE_KBD_DECODER is not set
CONFIG_RC_DEVICES=y
CONFIG_IR_GPIO_CIR=y
CONFIG_V4L_PLATFORM_DRIVERS=y
# CONFIG_MEDIA_SUBDRV_AUTOSELECT is not set
# CONFIG_TEGRA_NVMAP is not set
# CONFIG_TEGRA_DP is not set
# CONFIG_TEGRA_CAMERA_PLATFORM is not set
CONFIG_HIDRAW=y
CONFIG_UHID=y
CONFIG_HID_A4TECH=y
CONFIG_HID_ACRUX=y
CONFIG_HID_ACRUX_FF=y
CONFIG_HID_APPLE=y
CONFIG_HID_BELKIN=y
CONFIG_HID_CHERRY=y
CONFIG_HID_CHICONY=y
CONFIG_HID_CYPRESS=y
CONFIG_HID_DRAGONRISE=y
CONFIG_DRAGONRISE_FF=y
CONFIG_HID_EMS_FF=y
CONFIG_HID_ELECOM=y
CONFIG_HID_EZKEY=y
CONFIG_HID_KEYTOUCH=y
CONFIG_HID_KYE=y
CONFIG_HID_WALTOP=y
CONFIG_HID_GYRATION=y
CONFIG_HID_TWINHAN=y
CONFIG_HID_KENSINGTON=y
CONFIG_HID_LCPOWER=y
CONFIG_HID_LOGITECH=y
CONFIG_HID_LOGITECH_DJ=y
CONFIG_LOGITECH_FF=y
CONFIG_LOGIRUMBLEPAD2_FF=y
CONFIG_LOGIG940_FF=y
CONFIG_HID_MAGICMOUSE=y
CONFIG_HID_MICROSOFT=y
CONFIG_HID_MONTEREY=y
CONFIG_HID_MULTITOUCH=y
CONFIG_HID_ORTEK=y
CONFIG_HID_PANTHERLORD=y
CONFIG_PANTHERLORD_FF=y
CONFIG_HID_PETALYNX=y
CONFIG_HID_PICOLCD=y
CONFIG_HID_PRIMAX=y
CONFIG_HID_SAITEK=y
CONFIG_HID_SAMSUNG=y
CONFIG_HID_SPEEDLINK=y
CONFIG_HID_SUNPLUS=y
CONFIG_HID_GREENASIA=y
CONFIG_GREENASIA_FF=y
CONFIG_HID_SMARTJOYPLUS=y
CONFIG_SMARTJOYPLUS_FF=y
CONFIG_HID_TIVO=y
CONFIG_HID_TOPSEED=y
CONFIG_HID_THRUSTMASTER=y
CONFIG_HID_WACOM=y
CONFIG_HID_WIIMOTE=y
CONFIG_HID_ZEROPLUS=y
CONFIG_HID_ZYDACRON=y
# CONFIG_USB_SUPPORT is not set
CONFIG_LEDS_PWM=y
CONFIG_SWITCH=y
CONFIG_RTC_CLASS=y
CONFIG_DMADEVICES=y
CONFIG_TEGRA20_APB_DMA=y
CONFIG_STAGING=y
CONFIG_ASHMEM=y
CONFIG_ANDROID_TIMED_GPIO=y
CONFIG_ANDROID_LOW_MEMORY_KILLER=y
CONFIG_ION=y
CONFIG_FIQ_DEBUGGER=y
CONFIG_SYNC=y
CONFIG_SW_SYNC=y
CONFIG_SW_SYNC_USER=y
# CONFIG_TEGRA3_PM is not set
# CONFIG_TEGRA_POWERGATE is not set
# CONFIG_IOMMU_SUPPORT is not set
CONFIG_PM_DEVFREQ=y
CONFIG_EXTCON=y
CONFIG_EXTCON_ADC_JACK=y
CONFIG_EXTCON_GPIO=y
CONFIG_MEMORY=y
CONFIG_IIO=y
CONFIG_PWM=y
CONFIG_PWM_TEGRA=y
CONFIG_PWM_TEGRA_PMC_BLINK=y
CONFIG_ANDROID=y
CONFIG_ANDROID_BINDER_IPC=y
# CONFIG_GK20A is not set
CONFIG_EXT2_FS=y
CONFIG_EXT2_FS_XATTR=y
CONFIG_EXT2_FS_POSIX_ACL=y
CONFIG_EXT2_FS_SECURITY=y
CONFIG_EXT3_FS=y
CONFIG_EXT3_FS_POSIX_ACL=y
CONFIG_EXT3_FS_SECURITY=y
# CONFIG_DNOTIFY is not set
CONFIG_FUSE_FS=y
CONFIG_MSDOS_FS=y
CONFIG_VFAT_FS=y
CONFIG_TMPFS=y
CONFIG_TMPFS_POSIX_ACL=y
CONFIG_CONFIGFS_FS=y
CONFIG_PSTORE=y
CONFIG_PSTORE_CONSOLE=y
CONFIG_PSTORE_RAM=y
CONFIG_NFS_FS=y
CONFIG_ROOT_NFS=y
CONFIG_CIFS=y
CONFIG_NLS_CODEPAGE_437=y
CONFIG_NLS_ISO8859_1=y
CONFIG_PRINTK_TIME=y
CONFIG_DYNAMIC_DEBUG=y
CONFIG_DEBUG_INFO=y
CONFIG_READABLE_ASM=y
CONFIG_DEBUG_SECTION_MISMATCH=y
CONFIG_MAGIC_SYSRQ=y
CONFIG_DEBUG_KMEMLEAK=y
CONFIG_DEBUG_KMEMLEAK_EARLY_LOG_SIZE=2000
# CONFIG_DEBUG_KMEMLEAK_SCAN_ON is not set
CONFIG_LESS_GCC_OPT=y
CONFIG_LOCKUP_DETECTOR=y
# CONFIG_DETECT_HUNG_TASK is not set
CONFIG_SCHEDSTATS=y
CONFIG_TIMER_STATS=y
# CONFIG_DEBUG_PREEMPT is not set
CONFIG_DEBUG_ATOMIC_SLEEP=y
CONFIG_IRQSOFF_TRACER=y
CONFIG_CORESIGHT=y
CONFIG_CORESIGHT_LINK_AND_SINK_TMC=y
CONFIG_CORESIGHT_SINK_TPIU=y
CONFIG_CORESIGHT_SINK_ETBV10=y
CONFIG_CORESIGHT_SOURCE_ETM4X=y
CONFIG_CRYPTO_ECDH=y
CONFIG_CRYPTO_TEST=m
CONFIG_CRYPTO_TWOFISH=y
CONFIG_CRYPTO_LZO=y
CONFIG_CRYPTO_DEV_TEGRA_ELLIPTIC_SE=y
CONFIG_CRYPTO_DEV_TEGRA_SE=y
CONFIG_ARM64_CRYPTO=y
CONFIG_CRYPTO_SHA1_ARM64_CE=y
CONFIG_CRYPTO_SHA2_ARM64_CE=y
CONFIG_CRYPTO_GHASH_ARM64_CE=y
CONFIG_CRYPTO_AES_ARM64_CE_CCM=y
CONFIG_CRYPTO_AES_ARM64_CE_BLK=y
CONFIG_CRYPTO_AES_ARM64_NEON_BLK=y
CONFIG_CRC_CCITT=y
CONFIG_XZ_DEC=y
```

## kernel/kernel-4.4/arch/arm64/configs/tegra_t186ref_gnu_linux_early_boot_defconfig
```kconfig
CONFIG_ARCH_TEGRA_18x_SOC=y
# CONFIG_LOCALVERSION_AUTO is not set
CONFIG_NO_HZ=y
CONFIG_HIGH_RES_TIMERS=y
CONFIG_BLK_DEV_INITRD=y
CONFIG_EMBEDDED=y
CONFIG_SLAB=y
CONFIG_MODULES=y
# CONFIG_BLK_DEV_BSG is not set
CONFIG_ARCH_TEGRA=y
CONFIG_PREEMPT=y
CONFIG_CMA=y
# CONFIG_EFI is not set
CONFIG_COMPAT=y
CONFIG_PM_GENERIC_DOMAINS=y
CONFIG_NET=y
CONFIG_PACKET=y
CONFIG_INET=y
# CONFIG_INET_XFRM_MODE_TUNNEL is not set
# CONFIG_INET_XFRM_MODE_BEET is not set
# CONFIG_INET_DIAG is not set
# CONFIG_ANDROID_PARANOID_NETWORK is not set
CONFIG_DEVTMPFS=y
CONFIG_DEVTMPFS_MOUNT=y
CONFIG_DMA_CMA=y
CONFIG_CMA_SIZE_MBYTES=64
CONFIG_TEGRA_HV_BLKDEV=y
CONFIG_TEGRA_FUSE=y
CONFIG_NETDEVICES=y
CONFIG_TEGRA_HV_NET=y
# CONFIG_INPUT_MOUSE is not set
# CONFIG_LEGACY_PTYS is not set
# CONFIG_DEVKMEM is not set
CONFIG_SERIAL_8250=y
CONFIG_SERIAL_8250_CONSOLE=y
CONFIG_SERIAL_TEGRA=y
CONFIG_SERIAL_OF_PLATFORM=y
CONFIG_TEGRA_HV_COMM=y
# CONFIG_HW_RANDOM is not set
CONFIG_I2C_CHARDEV=y
CONFIG_I2C_TEGRA=y
CONFIG_WATCHDOG=y
CONFIG_WATCHDOG_CORE=y
CONFIG_TEGRA_HV_WATCHDOG=y
CONFIG_REGULATOR=y
CONFIG_REGULATOR_PMIC_OTP=y
CONFIG_REGULATOR_DUMMY=y
CONFIG_REGULATOR_FIXED_VOLTAGE=y
CONFIG_MEDIA_SUPPORT=y
CONFIG_MEDIA_CAMERA_SUPPORT=y
CONFIG_MEDIA_CONTROLLER=y
CONFIG_VIDEO_V4L2_SUBDEV_API=y
CONFIG_V4L_PLATFORM_DRIVERS=y
CONFIG_VIDEO_CAMERA=y
CONFIG_VIDEO_ISC=y
CONFIG_FB=y
CONFIG_TEGRA_GRHOST=y
CONFIG_NVMAP_CACHE_MAINT_BY_SET_WAYS=y
CONFIG_NVMAP_CACHE_MAINT_BY_SET_WAYS_ON_ONE_CPU=y
CONFIG_TEGRA_GR_VIRTUALIZATION=y
CONFIG_TEGRA_DC=y
CONFIG_TEGRA_NVDISPLAY=y
CONFIG_TEGRA_DSI=y
CONFIG_TEGRA_DSI2EDP_SN65DSI86=y
CONFIG_TEGRA_HDMI2_0=y
CONFIG_SWITCH=y
CONFIG_DMADEVICES=y
CONFIG_TEGRA186_GPC_DMA=y
CONFIG_VIRT_DRIVERS=y
CONFIG_TEGRA_VIRTUALIZATION=y
CONFIG_TEGRA_HV_MANAGER=y
CONFIG_STAGING=y
CONFIG_TEGRA_MC_DOMAINS=y
# CONFIG_TEGRA3_PM is not set
CONFIG_TEGRA_BWMGR=y
CONFIG_TEGRA_ISOMGR=y
CONFIG_TEGRA_CAMERA_RTCPU=y
# CONFIG_COMMON_CLK_XGENE is not set
CONFIG_MAILBOX=y
CONFIG_ARM_SMMU=y
# CONFIG_GK20A is not set
CONFIG_TEGRA_BPMP=y
CONFIG_EXT4_FS=y
CONFIG_EXT4_FS_POSIX_ACL=y
CONFIG_EXT4_FS_SECURITY=y
# CONFIG_DNOTIFY is not set
CONFIG_PRINTK_TIME=y
# CONFIG_DEBUG_PREEMPT is not set
CONFIG_STACKTRACE=y
```

## kernel/kernel-4.4/drivers/video/tegra/Kconfig
```kconfig
trysource "../nvhost/drivers/video/tegra/Kconfig"
trysource "../nvhost/drivers/video/tegra/Kconfig.nvhost"
trysource "drivers/video/tegra/Kconfig.nvhost"

config TEGRA_GRHOST_SYNC
	depends on TEGRA_GRHOST || TEGRA_HOST1X
	bool "Tegra host synchronization objects"
	default y
	select SYNC
	help
	  Add tegra host backend for the cross driver synchronization framework.
	  Allows creating sync fence file descriptors from Tegra host syncpoints.

trysource "../nvmap/drivers/video/tegra/nvmap/Kconfig"
trysource "../nvmap/drivers/video/tegra/nvmap/Kconfig.nvmap"
trysource "drivers/video/tegra/nvmap/Kconfig.nvmap"

if ARCH_TEGRA

config TEGRA_GR_VIRTUALIZATION
	bool "Tegra graphics virtualization support"
	default n
	depends on TEGRA_HV_MANAGER
	help
	  Adds Tegra graphics virtualization (host and gpu) support to client
	  drivers.

config TEGRA_DC
	tristate "Tegra Display Contoller"
	depends on (TEGRA_GRHOST || TEGRA_HOST1X) && I2C
	select BACKLIGHT_CLASS_DEVICE
	select FB_MODE_HELPERS
	help
	  Tegra display controller support.
	  Enable this to access the Tegra display controller using either framebuffer
	  console interface and a proprietary dc-ext interface or with ADF.

trysource ../display/drivers/video/tegra/Kconfig
trysource "../display/drivers/video/tegra/Kconfig.display"
trysource "drivers/video/tegra/Kconfig.display"

config TEGRA_CAMERA_PLATFORM
	bool "Enable tegra camera platform driver"
	depends on ARCH_TEGRA
	default y
	help
	  Enables tegra camera platform driver.
	  If unsure, say Y

endif
```

## tx2-baseboard-flasher/resources/linux-headers-4.4.38-antmicro/drivers/soc/tegra/Kconfig
```kconfig
config TEGRA_PROC_POWER_MODEL
	bool "Tegra process power model support"
	depends on ARCH_TEGRA
	help
	  Used to create a simple processor power model (PPM) by
	  collating various chip specific data including voltage,
	  frequency, and number of cores. This driver is used by
	  various other drivers including EDP.

config TEGRA_CPU_EDP
	bool "Enforce electrical design limits on CPU rail (CPU EDP)"
	depends on ARCH_TEGRA
	depends on CPU_FREQ && THERMAL
	default n
	select TEGRA_PROC_POWER_MODEL
	help
	  Enforce electrical design limits on CPU power rail. CPU
	  EDP prevents the CPU from drawing more current than its
	  voltage regulator can supply. Limit maximum CPU frequency
	  based on temperature and number of on-line CPUs to keep
	  CPU rail current within power supply capabilities.

config TEGRA_GPU_EDP
	bool "GPU EDP management"
	depends on THERMAL
	select TEGRA_PROC_POWER_MODEL
	default n
	help
	  Enforce electrical design limits on GPU power rail. GPU
	  EDP prevents the GPU from drawing more current than its
	  voltage regulator can supply. Limit maximum GPU frequency
	  based on temperature to keep GPU rail current within power
	  supply capabilities.

config TEGRA_DVFS
	bool
	depends on ARCH_TEGRA
	select PM_OPP
	help
	  This adds Tegra DVFS support. There could be several power
	  rails involved and there might be rails dependency based
	  on different SoCs, this config enable the generic DVFS
	  library needed by each SoCs DVFS files.

	  If in doubt, say N.

config TEGRA_210_DVFS
	bool "Tegra210 DVFS support"
	depends on ARCH_TEGRA_210_SOC
	select TEGRA_DVFS
	help
	  This enable Tegra210 DVFS functionality, it implements SoC
	  specific initialization code to be invoked by probe function
	  defined in generic Tegra DVFS driver, so while enabled it
	  needs the config TEGRA_DVFS to be enabled as well.

config TEGRA_KFUSE
	bool "Tegra kfuse support"
	default n
	depends on ARCH_TEGRA
	help
	  Enable Tegra kfuse support. The kfuse block stores downstream and
	  upstream HDCP keys for use by the HDMI module.

source "drivers/soc/tegra/sysedp/Kconfig"
```

## tx2-baseboard-module-install/resources/linux-headers-4.4.38-antmicro/drivers/soc/tegra/sysedp/Kconfig
```kconfig
menu "SYSEDP Framework"

config TEGRA_SYS_EDP
	bool "System EDP framework"
	default n
	help
	  SYSEDP-framework implements system peak current management.
	  It is a strategy that optimizes power performance within
	  the constraints of the system's power supply.
endmenu
```
